## base_external/package/LEDControlSvc/Config.in
```kconfig
config BR2_PACKAGE_LEDCONTROLSVC
	bool "LEDControlSvc"
	select HOST_SCONS
    select BR2_PACKAGE_AZURE_IOT_SDK_C
	select BR2_PACKAGE_LIBCONFIG
	help
	  Includes the LED Control Service for lighting addressable LED strings.
```

## buildroot/base_external/package/application/Config.in
```kconfig
config BR2_PACKAGE_APPLICATION
	bool "application"
	help
	  Includes the writer executable, finder.sh and tester.sh in the kernel image.
	  Used to understand buildroot external trees and package builds.
```
